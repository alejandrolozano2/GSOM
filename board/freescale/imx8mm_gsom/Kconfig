## board/freescale/imx8mm_gsom/Kconfig
```kconfig
 if TARGET_IMX8MM_GSOM

config SYS_BOARD
	default "imx8mm_gsom"

config SYS_VENDOR
	default "freescale"

config SYS_CONFIG_NAME
	default "imx8mm_gsom"

source "board/freescale/common/Kconfig"

endif
```
